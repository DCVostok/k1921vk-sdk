# K1921VK01T register map
Vendor: NIIET; Series: K1921VKx; File version: 2.2
Motor control ARM Cortex-M4F MCU
CPU: CM4 r0p1, little endian, MPU, FPU, 3 interrupt priority bits
Registers are 32-bit, read-write, reset 0x0 unless marked. A register's access mark holds for its fields unless they carry their own. Offsets are from the block's base; lines under a group give offsets from that group; [hi:lo] are bit positions; {n}, {i} and the like mark numbered series; 'fields as' and 'values as' point back to an identical list; <NAME> marks a mode.

## Memory map
0x80000000 NT_ADC size 0x3FC — ADC controller registers
0x80010000 NT_GPIOA size 0xC04 — GPIO controller regisres
0x80011000 NT_GPIOB size 0xC04
0x80012000 NT_GPIOC size 0xC04
0x80013000 NT_GPIOD size 0xC04
0x80014000 NT_GPIOE size 0xC04
0x80015000 NT_GPIOF size 0xC04
0x80016000 NT_GPIOG size 0xC04
0x80017000 NT_GPIOH size 0xC04
0x80030000 NT_COMMON_REG size 0x168 — Common block registers
0x80070000 NT_CAN size 0x3004 — CAN controller registers
0x80080000 NT_ETHERNET size 0x1A0 — ETHERNET controller registers
0x80090000 NT_USBHost size 0x34 — USB Host controller registers
0x80090000 NT_USBDevice size 0x70C — USB Device controller registers
0x80090704 NT_USBOTG size 0x80 — USB OTG controller registers
0xA0000000 NT_WDT size 0xC04 — Watchdog controller registers
0xA0001000 NT_I2C0 size 0x20 — I2C controller registers
0xA0002000 NT_I2C1 size 0x20
0xA0003000 NT_TIMER0 size 0x10 — TIMER controller registers
0xA0004000 NT_TIMER1 size 0x10
0xA0005000 NT_TIMER2 size 0x10
0xA0006000 NT_DMA size 0x50 — DMA controller registers
0xA0007000 NT_UART0 size 0x4C — UART controller registers
0xA0008000 NT_UART1 size 0x4C
0xA0009000 NT_UART2 size 0x4C
0xA000A000 NT_UART3 size 0x4C
0xA000B000 NT_PWM0 size 0xAC — PWM controller registers
{0xA000B000+0x1000*n} NT_PWM{n} size 0xAC (n=1..8)
0xA0014000 NT_CAP0 size 0x44 — CAP controller registers
0xA0015000 NT_CAP1 size 0x44
0xA0016000 NT_CAP2 size 0x44
0xA0017000 NT_CAP3 size 0x44
0xA0018000 NT_CAP4 size 0x44
0xA0019000 NT_CAP5 size 0x44
0xA001A000 NT_QEP0 size 0x74 — QEP controller registers
0xA001B000 NT_QEP1 size 0x74
0xA001C000 NT_BOOTFLASH size 0xA8 — BOOTFLASH controller registers
0xA001D000 NT_CMP size 0x80 — CMP controller registers
0xA001E000 NT_SPI0 size 0x28 — SPI controller registers
0xA001F000 NT_SPI1 size 0x28
0xA0020000 NT_SPI2 size 0x28
0xA0021000 NT_SPI3 size 0x28
0xA0022000 NT_USERFLASH size 0xA8 — USERFLASH controller registers
0xA0023000 NT_RTC size 0x34 — RTC controller registers

## NT_GPIOA — GPIO controller regisres
Base 0x80010000
Same registers: NT_GPIOB 0x80011000, NT_GPIOC 0x80012000, NT_GPIOD 0x80013000, NT_GPIOE 0x80014000, NT_GPIOF 0x80015000, NT_GPIOG 0x80016000, NT_GPIOH 0x80017000
0x00 DATA — Data input register
  [15:0] DATA
0x04 DATAOUT — Data output register
  [15:0] DATAOUT
0x10 OUTENSET — Output enable set register
  [15:0] OUTENSET
0x14 OUTENCLR — Output enable clear register
  [15:0] OUTENCLR
0x18 ALTFUNCSET — Alternative function set register
  [15:0] ALTFUNCSET
0x1C ALTFUNCCLR — Alternative function clear register
  [15:0] ALTFUNCCLR
0x20 INTENSET — Interrupt enable set register
  [15:0] INTENSET
0x24 INTENCLR — Interrupt enable clear register
  [15:0] INTENCLR
0x28 INTTYPESET — Interrupt type set register
  [15:0] INTTYPESET
0x2C INTTYPECLR — Interrupt type clear register
  [15:0] INTTYPECLR
0x30 INTPOLSET — Interrupt polarity set register
  [15:0] INTPOLSET
0x34 INTPOLCLR — Interrupt polarity clear register
  [15:0] INTPOLCLR
0x38 INTSTATUS — Interrupt status register
  [15:0] INTSTATUS
{0x400+4i} MASKLOWBYTE[{i}] (i=0..255) group
  0x00 MASKLOWBYTE — Lower byte masked access register
    [7:0] MASKLB — Data for lower byte masked access
{0x800+4i} MASKHIGHBYTE[{i}] (i=0..255) group
  0x00 MASKHIGHBYTE — Higher byte masked access register
    [15:8] MASKHB — Data for higher byte masked access

## Licence text in the file
ARM Limited (ARM) is supplying this software for use with Cortex-M processor based microcontroller, but can be equally used for other suitable processor architectures. This file can be freely distributed. Modifications to this file shall be clearly marked. . THIS SOFTWARE IS PROVIDED "AS IS". NO WARRANTIES, WHETHER EXPRESS, IMPLIED. OR STATUTORY, INCLUDING, BUT NOT LIMITED TO, IMPLIED WARRANTIES OF. MERCHANTABILITY AND FITNESS FOR A PARTICULAR PURPOSE APPLY TO THIS SOFTWARE. ARM SHALL NOT, IN ANY CIRCUMSTANCES, BE LIABLE FOR SPECIAL, INCIDENTAL, OR. CONSEQUENTIAL DAMAGES, FOR ANY REASON WHATSOEVER.
